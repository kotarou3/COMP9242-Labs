## apps/share_vm_test/Kconfig
```kconfig
config APP_SHARE_VM_TEST
    bool "sos_share_vm() tester"
    depends on HAVE_LIBC && LIB_CXX && LIB_BOOST
    default y
    select HAVE_SEL4_APPS
    help
        A tester for sos_share_vm()
```

## apps/thrasher/Kconfig
```kconfig
config APP_THRASHER
    bool "Thrasher"
    depends on HAVE_LIBC && LIB_CXX && LIB_BOOST
    default y
    select HAVE_SEL4_APPS
    help
        A tester for memory swapping
```
